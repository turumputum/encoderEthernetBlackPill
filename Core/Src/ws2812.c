#include "ws2812.h"
//----------------------------------------------------------------------------
extern TIM_HandleTypeDef htim1;
//----------------------------------------------------------------------------
uint16_t BUF_DMA [ARRAY_LEN] = {0};
uint8_t rgb_temp[12][3];
uint16_t DMA_BUF_TEMP[24];

const uint8_t gamma8[] = {
    0,  0,  0,  0,  0,  0,  0,  0,  0,  0,  0,  0,  0,  0,  0,  0,
    0,  0,  0,  0,  0,  0,  0,  0,  0,  0,  0,  0,  1,  1,  1,  1,
    1,  1,  1,  1,  1,  1,  1,  1,  1,  2,  2,  2,  2,  2,  2,  2,
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  215,218,220,223,225,228,231,233,236,239,241,244,247,249,252,255 };
//------------------------------------------------------------------



//------------------------------------------------------------------
void ws2812_light(void)
{
  HAL_TIM_PWM_Start_DMA(&htim1,TIM_CHANNEL_1,(uint32_t*)&BUF_DMA,ARRAY_LEN*2);
}



void ws2812_init(void)
{
  int i;
  for(i=DELAY_LEN;i<LED_COUNT*24;i++){
	  BUF_DMA[i] = LOW;

  }
}

void ws2812_clearBuf(){
	for( int i; i<LED_COUNT; i++){
		ws2812_pixel_rgb_to_buf_dma(0,0,0,i);
	}
}

void ws2812_setPixel_gammaCorrection(uint8_t Rpixel , uint8_t Gpixel, uint8_t Bpixel, uint16_t pos){
	ws2812_pixel_rgb_to_buf_dma(gamma8[Rpixel],gamma8[Gpixel],gamma8[Bpixel],pos);
}
//------------------------------------------------------------------
void ws2812_pixel_rgb_to_buf_dma(uint8_t Rpixel , uint8_t Gpixel, uint8_t Bpixel, uint16_t posX)
{
  volatile uint16_t i;
  for(i=0;i<8;i++)
  {
    if (BitIsSet(Rpixel,(7-i)) == 1)
    {
      BUF_DMA[DELAY_LEN+posX*24+i+8] = HIGH;
    }else
    {
      BUF_DMA[DELAY_LEN+posX*24+i+8] = LOW;
    }
    if (BitIsSet(Gpixel,(7-i)) == 1)
    {
      BUF_DMA[DELAY_LEN+posX*24+i+0] = HIGH;
    }else
    {
      BUF_DMA[DELAY_LEN+posX*24+i+0] = LOW;
    }
    if (BitIsSet(Bpixel,(7-i)) == 1)
    {
      BUF_DMA[DELAY_LEN+posX*24+i+16] = HIGH;
    }else
    {
      BUF_DMA[DELAY_LEN+posX*24+i+16] = LOW;
    }
  }
}

//------------------------------------------------------------------


